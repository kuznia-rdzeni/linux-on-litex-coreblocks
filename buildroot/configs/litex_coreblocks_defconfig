## buildroot/configs/litex_coreblocks_defconfig
```kconfig
# Target options
BR2_riscv=y
BR2_RISCV_32=y
BR2_RISCV_USE_MMU=y
BR2_RISCV_CUSTOM=y
BR2_riscv_g=n
BR2_riscv_custom=y
BR2_RISCV_ISA_RVM=y
BR2_RISCV_ISA_RVA=y
BR2_RISCV_ISA_RVF=n
BR2_RISCV_ISA_RVC=n
BR2_RISCV_ABI_ILP32=y

# Patches
BR2_GLOBAL_PATCH_DIR="$(BR2_EXTERNAL_LITEX_COREBLOCKS_PATH)/patches"

# GCC
BR2_GCC_VERSION_13_X=y

# System
BR2_TARGET_GENERIC_GETTY=y
BR2_TARGET_GENERIC_GETTY_PORT="ttyLXU0"

# Filesystem
# initrd
BR2_TARGET_ROOTFS_CPIO=y
BR2_TARGET_ROOTFS_CPIO_GZIP=y
BR2_TARGET_ROOTFS_INITRAMFS=n # don't link into kernel
# todo: rootfs + dracut

# Image
BR2_ROOTFS_POST_IMAGE_SCRIPT="$(BR2_EXTERNAL_LITEX_COREBLOCKS_PATH)/board/litex_coreblocks/post-image.sh"

# Kernel
BR2_LINUX_KERNEL=y
BR2_LINUX_KERNEL_CUSTOM_VERSION=y
BR2_LINUX_KERNEL_CUSTOM_VERSION_VALUE="6.9"
BR2_LINUX_KERNEL_USE_ARCH_DEFAULT_CONFIG=n
BR2_LINUX_KERNEL_USE_CUSTOM_CONFIG=y
BR2_LINUX_KERNEL_CUSTOM_CONFIG_FILE="$(BR2_EXTERNAL_LITEX_COREBLOCKS_PATH)/board/litex_coreblocks/linux.config"
BR2_LINUX_KERNEL_IMAGE=y
# Headers for build
BR2_PACKAGE_HOST_LINUX_HEADERS_CUSTOM_6_9=y

# OpenSBI
BR2_TARGET_OPENSBI=y
BR2_TARGET_OPENSBI_PLAT="generic"
BR2_TARGET_OPENSBI_INSTALL_DYNAMIC_IMG=n
BR2_TARGET_OPENSBI_INSTALL_JUMP_IMG=y
BR2_TARGET_OPENSBI_ADDITIONAL_VARIABLES="PLATFORM_RISCV_ISA=rv32ima_zicsr_zifencei FW_JUMP_ADDR=0x80400000 FW_FDT_PATH=$(BR2_EXTERNAL_LITEX_COREBLOCKS_PATH)/../images/rv32_litex_coreblocks_builtin.dtb"

# Rootfs customisation
BR2_ROOTFS_OVERLAY="$(BR2_EXTERNAL_LITEX_COREBLOCKS_PATH)/rootfsoverlay"

# Required tools to create the SD image
BR2_PACKAGE_HOST_DOSFSTOOLS=y
BR2_PACKAGE_HOST_GENIMAGE=y
BR2_PACKAGE_HOST_MTOOLS=y

# Extra packages
#BR2_PACKAGE_DHRYSTONE_OPT=y
#BR2_PACKAGE_MICROPYTHON=y
```
